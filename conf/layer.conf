## conf/layer.conf
```bitbake
# Copyright (C) 2020-2021, meta-linux-mainline contributors
# SPDX-License-Identifier: MIT

LAYERNAME = "meta-linux-mainline"
LAYERDEPENDS = "oe-core"
LAYERSERIES_COMPAT = "garburn"
```
