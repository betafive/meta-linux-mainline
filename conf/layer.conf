## conf/layer.conf
```bitbake
# Copyright (C) 2020-2021, meta-linux-mainline contributors
# SPDX-License-Identifier: MIT

# We have a conf and classes directory, append to BBPATH
BBPATH .= ":${LAYERDIR}"

# We have a recipes directory containing .bb and .bbappend files, add to BBFILES
BBFILES += "${LAYERDIR}/recipes-*/*/*.bb \
            ${LAYERDIR}/recipes-*/*/*.bbappend"

BBFILE_COLLECTIONS += "meta-linux-mainline"
BBFILE_PATTERN_meta-linux-mainline := "^${LAYERDIR}/"
BBFILE_PRIORITY_meta-linux-mainline = "5"

LAYERSERIES_COMPAT_meta-linux-mainline = "kirkstone scarthgap styhead walnascar"
LAYERDEPENDS_meta-linux-mainline = "core"

# We use patch files directly from kernel.org which do not include the
# Upstream-Status line required by Yocto Project.
ERROR_QA:remove:layer-meta-linux-mainline = "patch-status"

# Newer kernels use `truncate` during the build. As this is provided by
# coreutils, it should be safe to depend on this existing in the host system.
HOSTTOOLS += "truncate"
```
